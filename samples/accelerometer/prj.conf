## CMakeLists.txt
```
#
# Copyright (c) 2019-2022 Actinius
#
# SPDX-License-Identifier: BSD-3-Clause
#

cmake_minimum_required(VERSION 3.8.2)

find_package(Zephyr REQUIRED HINTS $ENV{ZEPHYR_BASE})
project(accelerometer_sample)

target_sources(app PRIVATE src/main.c)
target_sources(app PRIVATE src/accelerometer.c)
zephyr_include_directories(src)
```

## prj.conf
```kconfig
CONFIG_NEWLIB_LIBC=y
CONFIG_NEWLIB_LIBC_FLOAT_PRINTF=y

# I2C
CONFIG_I2C=y

# Accelerometer (LIS2DH)
CONFIG_SENSOR=y
CONFIG_LIS2DH=y
CONFIG_LIS2DH_ACCEL_RANGE_8G=y
CONFIG_LIS2DH_ODR_2=y

# MCUBoot
CONFIG_BOOTLOADER_MCUBOOT=y
```

## src/main.c
```c
/*
 * Copyright (c) 2019-2022 Actinius
 *
 * SPDX-License-Identifier: BSD-3-Clause
 */

#include "accelerometer.h"

#include <stdio.h>

int main(void)
{
	if (!init_accelerometer()) {
		return -1;
	}

	while (1) {
		printk("\033[1;1H");
		printk("\033[2J");

		double x_accel = 0;
		double y_accel = 0;
		double z_accel = 0;
		get_accelerometer_data(&x_accel, &y_accel, &z_accel);

		printk("Acceleration values:\n");
		printk("-------------------------------------------------------------------------------\n");
		printf("X: %lf (m/s^2), Y: %lf (m/s^2), Z: %lf (m/s^2)\n", x_accel, y_accel, z_accel);
		printk("-------------------------------------------------------------------------------\n");

		k_sleep(K_MSEC(200));
	}

	return 0;
}
```

## src/accelerometer.c
```c
/*
 * Copyright (c) 2019-2022 Actinius
 *
 * SPDX-License-Identifier: BSD-3-Clause
 */

#include "accelerometer.h"

#include <zephyr/drivers/sensor.h>

#define ACCEL_NODE DT_ALIAS(accel0)

const struct device *accel;

bool init_accelerometer(void)
{
	accel = DEVICE_DT_GET(ACCEL_NODE);

	if (!accel) {
		printk("Error getting accelerometer device binding\r\n");

		return false;
	}

	return true;
}

void get_accelerometer_data(double *x_accel, double *y_accel, double *z_accel)
{
	sensor_sample_fetch(accel);

	struct sensor_value value_x;
	sensor_channel_get(accel, SENSOR_CHAN_ACCEL_X, &value_x);
	*x_accel = sensor_value_to_double(&value_x);

	struct sensor_value value_y;
	sensor_channel_get(accel, SENSOR_CHAN_ACCEL_Y, &value_y);
	*y_accel = sensor_value_to_double(&value_y);

	struct sensor_value value_z;
	sensor_channel_get(accel, SENSOR_CHAN_ACCEL_Z, &value_z);
	*z_accel = sensor_value_to_double(&value_z);
}
```
