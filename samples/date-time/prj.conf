## CMakeLists.txt
```
# SPDX-License-Identifier: Apache-2.0

cmake_minimum_required(VERSION 3.13.1)

find_package(Zephyr HINTS $ENV{ZEPHYR_BASE})
project(external_rtc)

target_sources(app PRIVATE 
    src/main.c
    src/rtc.c
)
```

## sample.yaml
```
sample:
  name: RTC sample
tests:
  samples.nrf9160.rtc:
    build_only: true
    build_on_all: true
    platform_whitelist: actinius_icarus_ns
    tags: ci_build
```

## prj.conf
```kconfig
CONFIG_GPIO=y

# Newlibc
CONFIG_NEWLIB_LIBC=y
CONFIG_NEWLIB_LIBC_FLOAT_PRINTF=y

# Log
CONFIG_LOG=y
CONFIG_LOG_DEFAULT_LEVEL=3

# Network
CONFIG_NETWORKING=y
CONFIG_NET_NATIVE=n
CONFIG_NET_SOCKETS=y
CONFIG_NET_SOCKETS_OFFLOAD=y
CONFIG_NET_UDP=y
CONFIG_DNS_RESOLVER=y
CONFIG_NET_SOCKETS_POSIX_NAMES=y

# LTE link control
CONFIG_LTE_LINK_CONTROL=y
CONFIG_LTE_NETWORK_MODE_LTE_M_GPS=y

# Modem library
CONFIG_NRF_MODEM_LIB=y

# Date Time library
CONFIG_DATE_TIME=y

# Adding Peripherals
CONFIG_I2C=y

# RTC
CONFIG_RTC=y
CONFIG_COUNTER=y
CONFIG_PCF85063A=y

# MCUBoot settings
CONFIG_BOOTLOADER_MCUBOOT=y
```

## boards/actinius_icarus_ns.overlay
```dts
/ {
    aliases {
        rtc = &rtc0;
    };
};

&rtc0 {
    status = "okay";
};
```

## src/main.c
```c
#include <zephyr/kernel.h>
#include <zephyr/logging/log.h>
#include <stdio.h>
#include "rtc.h"

LOG_MODULE_REGISTER(main, CONFIG_LOG_DEFAULT_LEVEL);

void main(void)
{
    LOG_INF("Starting RTC application");
    
    // Initialize RTC
    if (!init_rtc()) {
        LOG_ERR("Failed to initialize RTC");
        return;
    }
    
    // Set initial time (March 19, 2025, 8:25 PM)
    set_rtc_time(2025, 3, 19, 20, 25, 0);
    
    while (1) {
        // Get current time
        struct datetime dt;
        get_datetime(&dt);
        
        // Print time to serial console
        printk("\033[1;1H");  // Move cursor to top-left
        printk("\033[2J");    // Clear screen
        
        printk("Current Date and Time\n");
        printk("-------------------------------------------------------------------------------\n");
        printf("Date: %04d-%02d-%02d\n", dt.year, dt.month, dt.day);
        printf("Time: %02d:%02d:%02d\n", dt.hour, dt.minute, dt.second);
        printk("-------------------------------------------------------------------------------\n");
        
        // Wait 1 second before updating
        k_sleep(K_SECONDS(1));
    }
}
```
