## CMakeLists.txt
```
#
# Copyright (c) 2019-2022 Actinius
#
# SPDX-License-Identifier: BSD-3-Clause
#

cmake_minimum_required(VERSION 3.8.2)

find_package(Zephyr REQUIRED HINTS $ENV{ZEPHYR_BASE})
project(sensor_lte_sample)

target_sources(app PRIVATE 
    src/main.c
    src/accelerometer.c
    src/gps.c
    src/rtc.c
    src/lte.c
    src/json_formatter.c
)

zephyr_include_directories(src)
```

## prj.conf
```kconfig
# Newlib C library
CONFIG_NEWLIB_LIBC=y
CONFIG_NEWLIB_LIBC_FLOAT_PRINTF=y

# I2C & Accelerometer (LIS2DH)
CONFIG_I2C=y
CONFIG_SENSOR=y
CONFIG_LIS2DH=y
CONFIG_LIS2DH_ACCEL_RANGE_8G=y
CONFIG_LIS2DH_ODR_2=y

# Modem & LTE Networking
CONFIG_NETWORKING=y
CONFIG_NET_SOCKETS=y
CONFIG_NET_SOCKETS_OFFLOAD=y
CONFIG_NET_MGMT=y
CONFIG_NET_MGMT_EVENT=y
CONFIG_NET_L2_PPP=y

# Modem support & AT commands (for GPS)
CONFIG_MODEM=y
CONFIG_MODEM_INFO=y
CONFIG_MODEM_SHELL=y
CONFIG_AT_CMD=y

# RTC & Date-Time support 
CONFIG_CLOCK_CONTROL=y
CONFIG_CLOCK_CONTROL_NRF=y
CONFIG_RTC=y
CONFIG_DATE_TIME=y

# JSON parsing library
CONFIG_JSON_LIBRARY=y

# MCUBoot bootloader support 
CONFIG_BOOTLOADER_MCUBOOT=y

# Logging subsystem 
CONFIG_LOG=y
CONFIG_LOG_DEFAULT_LEVEL=3

# POSIX API (instead of deprecated NET_SOCKETS_POSIX_NAMES)
CONFIG_POSIX_API=y
```

## boards/actinius_icarus_ns.overlay
```dts
&sim_select {
    sim = "esim";
};
```

## src/main.c
```c
/*
 * Copyright (c) 2019-2022 Actinius
 *
 * SPDX-License-Identifier: BSD-3-Clause
 */

#include "accelerometer.h"
#include "gps.h"
#include "rtc.h"
#include "lte.h"
#include "json_formatter.h"

#include <stdio.h>
#include <zephyr/logging/log.h>

LOG_MODULE_REGISTER(main, CONFIG_LOG_DEFAULT_LEVEL);

void main(void)
{
    LOG_INF("Starting sensor data collection application");
    
    // Initialize all subsystems
    if (!init_accelerometer()) {
        LOG_ERR("Failed to initialize accelerometer");
        return;
    }
    
    struct gps_data gps_info;
    if (!init_gps()) {
        LOG_WRN("Failed to initialize GPS, continuing without GPS data");
    } else {
        printk("GPS initialized successfully\n");
    }
    
    if (!init_rtc()) {
        LOG_WRN("Failed to initialize RTC, continuing with default time");
    }
    
    if (!init_lte()) {
        LOG_WRN("Failed to initialize LTE, data will not be transmitted");
    }
    
    LOG_INF("All subsystems initialized, starting main loop");
    
    while (1) {
        // Clear screen for serial output
        printk("\033[1;1H");
        printk("\033[2J");
        
        // Get accelerometer data
        double x_accel = 0;
        double y_accel = 0;
        double z_accel = 0;
        get_accelerometer_data(&x_accel, &y_accel, &z_accel);
        
        // Get current time
        struct datetime dt;
        get_datetime(&dt);
        
        // Format data as JSON
        char *json_data = format_sensor_data_json(x_accel, y_accel, z_accel, &gps_data, &dt);

        printk("Attempting to get GPS data...\n");

        if (get_gps_data(&gps_info)) {
            printk("GPS Data:\n");
            printk("Latitude: %.6f\n", gps_info.latitude);
            printk("Longitude: %.6f\n", gps_info.longitude);
            printk("Altitude: %.2f m\n", gps_info.altitude);
            printk("Speed: %.2f knots\n", gps_info.speed);
            printk("Timestamp: %s\n", gps_info.datetime);
        } else {
            printk("Failed to acquire GPS fix.\n");
        }

        k_sleep(K_SECONDS(180)); // Wait before next attempt
        
        // Print data to serial console
        printk("Sensor Data\n");
        printk("-------------------------------------------------------------------------------\n");
        printf("Date/Time: %04d-%02d-%02d %02d:%02d:%02d EST\n", 
               dt.year, dt.month, dt.day, dt.hour, dt.minute, dt.second);
        printf("Acceleration: X: %lf (m/s^2), Y: %lf (m/s^2), Z: %lf (m/s^2)\n", 
               x_accel, y_accel, z_accel);
        printk("-------------------------------------------------------------------------------\n");
        printf("JSON Data: %s\n", json_data);
        printk("-------------------------------------------------------------------------------\n");
        
        // Send data over LTE if connected
        if (lte_is_connected()) {
            if (lte_send_data(json_data, strlen(json_data))) {
                printk("Data successfully sent over LTE\n");
            } else {
                printk("Failed to send data over LTE\n");
            }
        } else {
            printk("LTE not connected, data not sent\n");
			printk("LTE connection lost, attempting to reconnect...\n");
    		if (!lte_reconnect()) {
        		printk("Failed to reconnect LTE\n");
        		// Handle reconnection failure
				lte_shutdown();
    		} else {
        		printk("LTE reconnected successfully\n");
    		}
        }

        
        // Wait for 3 seconds before collecting new data
        k_sleep(K_SECONDS(3));
    }
}
```

## src/accelerometer.h
```c
/*
 * Copyright (c) 2019-2022 Actinius
 *
 * SPDX-License-Identifier: BSD-3-Clause
 */

#ifndef _ACCELEROMETER_H_
#define _ACCELEROMETER_H_

#include <zephyr/kernel.h>

bool init_accelerometer(void);
void get_accelerometer_data(double *x_accel, double *y_accel, double *z_accel);

#endif // _ACCELEROMETER_H_
```

## src/gps.c
```c
#include "gps.h"
#include <zephyr/kernel.h>
#include <modem/at_cmd.h>
#include <zephyr/logging/log.h>
#include <stdio.h>
#include <string.h>

LOG_MODULE_REGISTER(gps, CONFIG_LOG_DEFAULT_LEVEL);

#define GPS_AT_CMD_BUF_SIZE 256
static char at_resp_buf[GPS_AT_CMD_BUF_SIZE];

bool init_gps(void)
{
    int err;

    // Set modem to LTE-M + GPS mode
    err = at_cmd_write("AT%XSYSTEMMODE=1,0,1,0", NULL, 0, NULL);
    if (err) {
        LOG_ERR("Failed to set LTE-M + GPS mode, error: %d", err);
        return false;
    }

    // Configure GPS antenna coexistence settings (recommended)
    err = at_cmd_write("AT%XCOEX0=1,1,1565,1586", NULL, 0, NULL);
    if (err) {
        LOG_ERR("Failed to configure COEX0 for GPS: %d", err);
        return false;
    }

    LOG_INF("GPS initialized via AT commands");
    return true;
}

static bool parse_gps_response(const char *resp, struct gps_data *data)
{
    int fix_status;
    int year, month, day, hour, minute;
    float seconds;
    float latitude, longitude, altitude, speed;

    // Parse the response from AT command +CGPSINFO
    // Response format: +CGPSINFO: <lat>,<N/S>,<lon>,<E/W>,<date>,<UTC time>,<altitude>,<speed>
    if (strstr(resp, "+CGPSINFO: ,,,,,,,") != NULL) {
        LOG_WRN("No GPS fix available yet");
        return false; // No fix yet
    }

    char lat_dir, lon_dir;
    char date[7], utc_time[10];

    int matched = sscanf(resp,
        "+CGPSINFO: %f,%c,%f,%c,%6[^,],%9[^,],%f,%f",
        &latitude,
        &lat_dir,
        &longitude,
        &lon_dir,
        date,
        utc_time,
        &altitude,
        &speed);

    if (matched != 8) {
        LOG_ERR("Failed to parse GPS response correctly");
        return false;
    }

    // Convert latitude and longitude to decimal degrees
    int lat_deg = (int)(latitude / 100);
    float lat_min = latitude - (lat_deg * 100);
    data->latitude = lat_deg + lat_min / 60.0;
    if (lat_dir == 'S') data->latitude *= -1;

    int lon_deg = (int)(longitude / 100);
    float lon_min = longitude - (lon_deg * 100);
    data->longitude = lon_deg + lon_min / 60.0;
    if (lon_dir == 'W') data->longitude *= -1;

    data->altitude = altitude;
    data->speed = speed;

    // Parse date and time into readable format
    sscanf(date, "%2d%2d%2d", &day, &month, &year);
    sscanf(utc_time, "%2d%2d%f", &hour, &minute, &seconds);

    snprintf(data->datetime, sizeof(data->datetime),
             "20%02d-%02d-%02d %02d:%02d:%02.0f UTC",
             year, month, day,
             hour, minute, seconds);

    return true;
}

bool get_gps_data(struct gps_data *data)
{
    int err;

    // Start GPS session
    err = at_cmd_write("AT+CFUN=31", NULL, 0, NULL); // Activate GNSS only mode temporarily
    if (err) {
        LOG_ERR("Failed to activate GPS mode: %d", err);
        return false;
    }

    LOG_INF("Waiting for GPS fix...");
    
    bool fix_acquired = false;
    
    for (int retries = 0; retries < 120; retries++) { // wait up to ~120 seconds
        k_sleep(K_SECONDS(1));

        memset(at_resp_buf, 0, sizeof(at_resp_buf));
        
        err = at_cmd_write("AT+CGPSINFO", at_resp_buf, sizeof(at_resp_buf), NULL);
        
        if (err) {
            LOG_ERR("Failed to query GPS info: %d", err);
            continue; // retry again
        }

        if (parse_gps_response(at_resp_buf, data)) {
            fix_acquired = true;
            break; // Fix acquired successfully
        }
        
        LOG_INF("GPS fix not yet available (%d/120)", retries + 1);
    }

    // Restore normal LTE functionality after GPS session
    err = at_cmd_write("AT+CFUN=1", NULL, 0, NULL); 
    if (err) {
        LOG_WRN("Failed to restore LTE functionality after GPS session");
        // Not critical; proceed anyway
    }

    if (!fix_acquired) {
        LOG_ERR("GPS fix was not acquired within timeout");
        return false;
    }

    LOG_INF("GPS fix acquired successfully");
    
    return true;
}
```

## src/gps.h
```c
#ifndef _GPS_H_
#define _GPS_H_

#include <zephyr/kernel.h>
#include <stdbool.h>

struct gps_data {
    double latitude;
    double longitude;
    double altitude;
    double speed;
    char datetime[32]; // formatted date-time string
};

bool init_gps(void);
bool get_gps_data(struct gps_data *data);

#endif // _GPS_H_
```

## src/json_formatter.c
```c
#include "json_formatter.h"
#include <zephyr/data/json.h>
#include <stdio.h>
#include <string.h>
#include <zephyr/logging/log.h>

LOG_MODULE_REGISTER(json, CONFIG_LOG_DEFAULT_LEVEL);

static char json_buffer[512];

struct sensor_data {
    char datetime[32];
    double latitude;
    double longitude;
    double altitude;
    double x_accel;
    double y_accel;
    double z_accel;
};

static const struct json_obj_descr sensor_data_descr[] = {
    JSON_OBJ_DESCR_PRIM(struct sensor_data, datetime, JSON_TOK_STRING),
    JSON_OBJ_DESCR_PRIM(struct sensor_data, latitude, JSON_TOK_FLOAT),
    JSON_OBJ_DESCR_PRIM(struct sensor_data, longitude, JSON_TOK_FLOAT),
    JSON_OBJ_DESCR_PRIM(struct sensor_data, altitude, JSON_TOK_FLOAT),
    JSON_OBJ_DESCR_PRIM(struct sensor_data, x_accel, JSON_TOK_FLOAT),
    JSON_OBJ_DESCR_PRIM(struct sensor_data, y_accel, JSON_TOK_FLOAT),
    JSON_OBJ_DESCR_PRIM(struct sensor_data, z_accel, JSON_TOK_FLOAT),
};

static int json_append_data(const char *bytes, size_t len, void *data)
{
    char *str = (char *)data;
    memcpy(str + strlen(str), bytes, len);
    return 0;
}

char *format_sensor_data_json(double x_accel, double y_accel, double z_accel,
                             struct gps_data *gps, struct datetime *dt)
{
    struct sensor_data data;
    
    // Format datetime
    snprintf(data.datetime, sizeof(data.datetime), 
             "%04d-%02d-%02d %02d:%02d:%02d EST",
             dt->year, dt->month, dt->day, dt->hour, dt->minute, dt->second);
    
    // Set GPS data
    data.latitude = gps->latitude;
    data.longitude = gps->longitude;
    data.altitude = gps->altitude;
    
    // Set accelerometer data
    data.x_accel = x_accel;
    data.y_accel = y_accel;
    data.z_accel = z_accel;
    
    // Clear buffer
    memset(json_buffer, 0, sizeof(json_buffer));
    
    // Encode data to JSON
    int ret = json_obj_encode(sensor_data_descr, 
                             ARRAY_SIZE(sensor_data_descr),
                             &data, json_append_data, json_buffer);
                            
    if (ret < 0) {
        LOG_ERR("Failed to encode data to JSON, error: %d", ret);
        strcpy(json_buffer, "{\"error\":\"Failed to encode JSON\"}");
    }
    
    return json_buffer;
}
```

## src/json_formatter.h
```c
#ifndef _JSON_FORMATTER_H_
#define _JSON_FORMATTER_H_

#include <zephyr/kernel.h>
#include "accelerometer.h"
#include "gps.h"
#include "rtc.h"

char *format_sensor_data_json(double x_accel, double y_accel, double z_accel,
                              struct gps_data *gps, struct datetime *dt);

#endif // _JSON_FORMATTER_H_
```

## src/lte.c
```c
#include "lte.h"
#include <zephyr/logging/log.h>
#include <zephyr/net/socket.h>
#include <zephyr/net/net_if.h>
#include <zephyr/net/net_mgmt.h>
#include <zephyr/net/dns_resolve.h>
#include <zephyr/pm/device.h>
#include <zephyr/pm/device_runtime.h>
#include <modem/lte_lc.h>
#include <modem/modem_info.h>
#include <string.h>

LOG_MODULE_REGISTER(lte, CONFIG_LOG_DEFAULT_LEVEL);

#define SERVER_HOSTNAME "example.com"
#define SERVER_PORT 8080
#define DNS_TIMEOUT_MS 20000

static bool connected;
static int client_fd = -1;
static struct sockaddr_storage server_addr;
static struct net_if *iface;
static const struct device *modem;

// DNS resolution helpers
static bool dns_query_in_progress;
static struct dns_addrinfo dns_addrinfo;
K_SEM_DEFINE(dns_query_sem, 0, 1);

static void dns_request_result(enum dns_resolve_status status, struct dns_addrinfo *info,
                              void *user_data)
{
    if (dns_query_in_progress == false) {
        return;
    }

    if (status != DNS_EAI_INPROGRESS) {
        return;
    }

    dns_query_in_progress = false;
    dns_addrinfo = *info;
    k_sem_give(&dns_query_sem);
}

static int perform_dns_request(const char *hostname)
{
    static uint16_t dns_id;
    int ret;

    LOG_INF("Performing DNS lookup for %s", hostname);
    
    dns_query_in_progress = true;
    ret = dns_get_addr_info(hostname,
                          DNS_QUERY_TYPE_A,
                          &dns_id,
                          dns_request_result,
                          NULL,
                          DNS_TIMEOUT_MS);
    if (ret < 0) {
        LOG_ERR("Failed to start DNS query, error: %d", ret);
        return -EAGAIN;
    }

    if (k_sem_take(&dns_query_sem, K_MSEC(DNS_TIMEOUT_MS)) < 0) {
        LOG_ERR("DNS query timed out");
        return -EAGAIN;
    }

    return 0;
}

void lte_get_modem_info(void)
{
    int rc;
    char buffer[64];

    if (!modem) {
        LOG_ERR("Modem not initialized");
        return;
    }

    // Get IMEI
    rc = modem_info_string_get(MODEM_INFO_IMEI, buffer, sizeof(buffer));
    if (rc >= 0) {
        LOG_INF("Modem IMEI: %s", buffer);
    } else {
        LOG_ERR("Failed to get IMEI, error: %d", rc);
    }

    // Get ICCID (SIM card ID)
    rc = modem_info_string_get(MODEM_INFO_ICCID, buffer, sizeof(buffer));
    if (rc >= 0) {
        LOG_INF("SIM ICCID: %s", buffer);
    } else {
        LOG_ERR("Failed to get ICCID, error: %d", rc);
    }

    // Get signal strength
    rc = modem_info_string_get(MODEM_INFO_RSRP, buffer, sizeof(buffer));
    if (rc >= 0) {
        LOG_INF("Signal strength (RSRP): %s", buffer);
    }

    // Get current operator
    rc = modem_info_string_get(MODEM_INFO_OPERATOR, buffer, sizeof(buffer));
    if (rc >= 0) {
        LOG_INF("Network operator: %s", buffer);
    }

    // Get IP address
    rc = modem_info_string_get(MODEM_INFO_IP_ADDRESS, buffer, sizeof(buffer));
    if (rc >= 0) {
        LOG_INF("IP address: %s", buffer);
    }
}

bool init_lte(void)
{
    int err;

    // Get modem device
    modem = DEVICE_DT_GET(DT_ALIAS(modem));
    if (!modem) {
        LOG_ERR("Failed to get modem device");
        return false;
    }

    // Power on modem
    LOG_INF("Powering on modem");
    err = pm_device_action_run(modem, PM_DEVICE_ACTION_RESUME);
    if (err) {
        LOG_ERR("Failed to power on modem, error: %d", err);
        return false;
    }

    // Initialize the modem info module
    err = modem_info_init();
    if (err) {
        LOG_ERR("Failed to initialize modem info module, error: %d", err);
        return false;
    }

    // Get the PPP network interface
    iface = net_if_get_first_by_type(&NET_L2_GET_NAME(PPP));
    if (!iface) {
        LOG_ERR("Failed to find PPP network interface");
        return false;
    }

    // Bring up network interface
    LOG_INF("Bringing up network interface");
    err = net_if_up(iface);
    if (err < 0) {
        LOG_ERR("Failed to bring up network interface, error: %d", err);
        return false;
    }

    // Wait for L4 connection (IP connectivity)
    LOG_INF("Waiting for L4 connectivity...");
    err = net_mgmt_event_wait_on_iface(iface, NET_EVENT_L4_CONNECTED, NULL, NULL, NULL,
                                     K_SECONDS(120));
    if (err != 0) {
        LOG_ERR("L4 was not connected in time");
        return false;
    }
    LOG_INF("L4 connected");

    // Wait for DNS server to be added
    LOG_INF("Waiting for DNS server...");
    err = net_mgmt_event_wait_on_iface(iface, NET_EVENT_DNS_SERVER_ADD, NULL, NULL, NULL,
                                     K_SECONDS(10));
    if (err) {
        LOG_WRN("DNS server was not added in time, continuing anyway");
    } else {
        LOG_INF("DNS server added");
    }

    // Display modem information
    lte_get_modem_info();
    connected = true;

    // Perform DNS lookup for server
    err = perform_dns_request(SERVER_HOSTNAME);
    if (err < 0) {
        LOG_ERR("DNS query failed");
        return false;
    }

    // Log the resolved IP address
    {
        char ip_str[INET6_ADDRSTRLEN];
        const void *src;
        uint16_t *port;

        switch (dns_addrinfo.ai_addr.sa_family) {
        case AF_INET:
            src = &net_sin(&dns_addrinfo.ai_addr)->sin_addr;
            port = &net_sin(&dns_addrinfo.ai_addr)->sin_port;
            break;
        case AF_INET6:
            src = &net_sin6(&dns_addrinfo.ai_addr)->sin6_addr;
            port = &net_sin6(&dns_addrinfo.ai_addr)->sin6_port;
            break;
        default:
            LOG_ERR("Unsupported address family");
            return false;
        }
        inet_ntop(dns_addrinfo.ai_addr.sa_family, src, ip_str, sizeof(ip_str));
        LOG_INF("Resolved %s to %s", SERVER_HOSTNAME, ip_str);
    }

    // Set up sockaddr for the server
    memcpy(&server_addr, &dns_addrinfo.ai_addr, dns_addrinfo.ai_addrlen);
    ((struct sockaddr_in *)&server_addr)->sin_port = htons(SERVER_PORT);

    // Create socket
    client_fd = socket(AF_INET, SOCK_STREAM, IPPROTO_TCP);
    if (client_fd < 0) {
        LOG_ERR("Failed to create socket, error: %d", errno);
        return false;
    }

    // Connect to server
    LOG_INF("Connecting to server %s:%d", SERVER_HOSTNAME, SERVER_PORT);
    err = connect(client_fd, (struct sockaddr *)&server_addr, sizeof(struct sockaddr_in));
    if (err < 0) {
        LOG_ERR("Failed to connect to server, error: %d", errno);
        close(client_fd);
        client_fd = -1;
        return false;
    }

    LOG_INF("Connected to server %s:%d", SERVER_HOSTNAME, SERVER_PORT);
    return true;
}

bool lte_send_data(const char *data, size_t len)
{
    if (!connected || client_fd < 0) {
        LOG_ERR("LTE not connected");
        return false;
    }

    int ret = send(client_fd, data, len, 0);
    if (ret < 0) {
        LOG_ERR("Failed to send data, error: %d", errno);
        return false;
    }

    LOG_INF("Sent %d bytes to server", ret);
    return true;
}

bool lte_is_connected(void)
{
    return connected && (client_fd >= 0);
}

bool lte_reconnect(void)
{
    LOG_INF("Attempting to reconnect LTE");
    
    // Close existing socket if open
    if (client_fd >= 0) {
        close(client_fd);
        client_fd = -1;
    }
    
    // Restart modem
    LOG_INF("Restarting modem");
    int ret = pm_device_action_run(modem, PM_DEVICE_ACTION_SUSPEND);
    if (ret != 0) {
        LOG_ERR("Failed to power down modem, error: %d", ret);
        return false;
    }
    
    k_sleep(K_SECONDS(1));
    
    ret = pm_device_action_run(modem, PM_DEVICE_ACTION_RESUME);
    if (ret != 0) {
        LOG_ERR("Failed to power up modem, error: %d", ret);
        return false;
    }
    
    // Wait for L4 connection
    LOG_INF("Waiting for L4 connectivity...");
    ret = net_mgmt_event_wait_on_iface(iface, NET_EVENT_L4_CONNECTED, NULL, NULL, NULL,
                                     K_SECONDS(60));
    if (ret != 0) {
        LOG_ERR("L4 was not connected in time");
        return false;
    }
    LOG_INF("L4 connected");
    
    // Wait a bit to stabilize
    k_sleep(K_SECONDS(5));
    
    // Create socket
    client_fd = socket(AF_INET, SOCK_STREAM, IPPROTO_TCP);
    if (client_fd < 0) {
        LOG_ERR("Failed to create socket, error: %d", errno);
        return false;
    }
    
    // Connect to server
    ret = connect(client_fd, (struct sockaddr *)&server_addr, sizeof(struct sockaddr_in));
    if (ret < 0) {
        LOG_ERR("Failed to connect to server, error: %d", errno);
        close(client_fd);
        client_fd = -1;
        return false;
    }
    
    LOG_INF("Reconnected to server");
    connected = true;
    return true;
}

void lte_shutdown(void)
{
    LOG_INF("Shutting down LTE connection");
    
    // Close socket if open
    if (client_fd >= 0) {
        close(client_fd);
        client_fd = -1;
    }
    
    // Bring down network interface
    if (iface) {
        int ret = net_if_down(iface);
        if (ret < 0) {
            LOG_ERR("Failed to bring down network interface, error: %d", ret);
        }
    }
    
    // Power down modem
    if (modem) {
        int ret = pm_device_action_run(modem, PM_DEVICE_ACTION_SUSPEND);
        if (ret != 0) {
            LOG_ERR("Failed to power down modem, error: %d", ret);
        } else {
            LOG_INF("Modem powered down");
        }
    }
    
    connected = false;
}
```

## src/lte.h
```c
#ifndef _LTE_H_
#define _LTE_H_

#include <zephyr/kernel.h>
#include <stdbool.h>

bool init_lte(void);
bool lte_send_data(const char *data, size_t len);
bool lte_is_connected(void);
void lte_get_modem_info(void);
bool lte_reconnect(void);
void lte_shutdown(void);

#endif // _LTE_H_
```

## src/rtc.c
```c
#include "rtc.h"
#include <date_time.h>
#include <zephyr/device.h>
#include <zephyr/drivers/clock_control.h>
#include <zephyr/drivers/clock_control/nrf_clock_control.h>
#include <zephyr/logging/log.h>
#include <stdio.h>

LOG_MODULE_REGISTER(rtc, CONFIG_LOG_DEFAULT_LEVEL);

static char datetime_str[32];

bool init_rtc(void)
{
    const struct device *clock;
    int err;

    clock = device_get_binding(DT_LABEL(DT_INST(0, nordic_nrf_clock)));
    if (!clock) {
        LOG_ERR("Could not get clock device");
        return false;
    }

    err = clock_control_on(clock, CLOCK_CONTROL_NRF_SUBSYS_LF);
    if (err) {
        LOG_ERR("Could not start LF clock, error: %d", err);
        return false;
    }

    err = date_time_initialize();
    if (err) {
        LOG_ERR("Failed to initialize date time library, error: %d", err);
        return false;
    }

    LOG_INF("RTC initialized");
    return true;
}

void get_datetime(struct datetime *dt)
{
    int64_t unix_time_ms = 0;
    int err = date_time_now(&unix_time_ms);
    
    // Eastern Time Zone offset (-5 hours in standard time)
    // Note: This doesn't account for daylight saving
    int64_t est_offset_ms = -5 * 60 * 60 * 1000;
    unix_time_ms += est_offset_ms;
    
    if (err) {
        LOG_WRN("Failed to get current time, error: %d", err);
        dt->year = 2025;
        dt->month = 3;
        dt->day = 19;
        dt->hour = 0;
        dt->minute = 0;
        dt->second = 0;
        return;
    }

    // Convert unix timestamp (ms) to datetime components
    int64_t unix_time_s = unix_time_ms / 1000;
    int64_t time_of_day = unix_time_s % (24 * 60 * 60);
    
    dt->hour = time_of_day / 3600;
    dt->minute = (time_of_day % 3600) / 60;
    dt->second = time_of_day % 60;
    
    // This is a very simplified date calculation 
    // A better implementation would use a proper date/time library
    // But for Zephyr 2.7.x with limited resources, this will give basic functionality
    int64_t days_since_epoch = unix_time_s / (24 * 60 * 60);
    
    // Rough calculation - not accounting for leap years perfectly
    dt->year = 1970 + (days_since_epoch / 365);
    int day_of_year = days_since_epoch % 365;
    
    // Simple month determination
    static const int days_in_month[] = {31, 28, 31, 30, 31, 30, 31, 31, 30, 31, 30, 31};
    int month = 0;
    int days = day_of_year;
    
    while (month < 12) {
        int days_this_month = days_in_month[month];
        // Rough leap year adjustment for February
        if (month == 1 && dt->year % 4 == 0) {
            days_this_month = 29;
        }
        
        if (days < days_this_month) {
            break;
        }
        
        days -= days_this_month;
        month++;
    }
    
    dt->month = month + 1;
    dt->day = days + 1;
}

char *get_datetime_str(void)
{
    struct datetime dt;
    get_datetime(&dt);
    
    snprintf(datetime_str, sizeof(datetime_str), 
             "%04d-%02d-%02d %02d:%02d:%02d EST",
             dt.year, dt.month, dt.day, dt.hour, dt.minute, dt.second);
    
    return datetime_str;
}
```

## src/rtc.h
```c
#ifndef _RTC_H_
#define _RTC_H_

#include <zephyr/kernel.h>
#include <stdbool.h>

struct datetime {
    int year;
    int month;
    int day;
    int hour;
    int minute;
    int second;
};

bool init_rtc(void);
void get_datetime(struct datetime *dt);
char *get_datetime_str(void);

#endif // _RTC_H_
```
