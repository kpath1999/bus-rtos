## CMakeLists.txt
```
#
# Copyright (c) 2019 Nordic Semiconductor
#
# SPDX-License-Identifier: Apache-2.0, LicenseRef-BSD-5-Clause-Nordic

cmake_minimum_required(VERSION 3.20.0)

find_package(Zephyr HINTS $ENV{ZEPHYR_BASE})
find_package(Zephyr REQUIRED HINTS $ENV{ZEPHYR_BASE})
project(bus_rtos)

zephyr_library_sources(src/startup.c)
zephyr_library_sources(src/main.c)

zephyr_library_sources_ifdef(CONFIG_GNSS_SAMPLE_ASSISTANCE_NRF_CLOUD src/assistance.c)
zephyr_library_sources_ifdef(CONFIG_GNSS_SAMPLE_ASSISTANCE_SUPL src/assistance_supl.c)
zephyr_library_sources_ifdef(CONFIG_GNSS_SAMPLE_ASSISTANCE_MINIMAL src/assistance_minimal.c)
zephyr_library_sources_ifdef(CONFIG_GNSS_SAMPLE_ASSISTANCE_MINIMAL src/mcc_location_table.c)

target_sources(app PRIVATE 
    src/main.c
    src/rtc.c
    src/accelerometer.c
)
```

## sample.yaml
```
sample:
  name: Bus RTOS firmware
  description: Firmware for the StingSense project
tests:
  test_build:
    build_only: true
    build_on_all: true
    platform_whitelist: actinius_icarus_ns
    tags: ci_build
  sample.cellular.gnss:
    sysbuild: true
    build_only: true
    integration_platforms:
      - nrf9151dk/nrf9151/ns
      - nrf9160dk/nrf9160/ns
      - nrf9161dk/nrf9161/ns
    platform_allow:
      - nrf9151dk/nrf9151/ns
      - nrf9160dk/nrf9160/ns
      - nrf9161dk/nrf9161/ns
    tags: ci_build sysbuild
  samples.nrf9160.gps:
    build_only: true
    build_on_all: true
    platform_whitelist: actinius_icarus_ns
    tags: ci_build
  samples.nrf9160.rtc:
    build_only: true
    build_on_all: true
    platform_whitelist: actinius_icarus_ns
    tags: ci_build
```

## prj.conf
```kconfig
#
# Copyright (c) 2019 Nordic Semiconductor ASA
#
# SPDX-License-Identifier: LicenseRef-Nordic-5-Clause
#

# General
CONFIG_FPU=y
CONFIG_STDOUT_CONSOLE=y
CONFIG_UART_INTERRUPT_DRIVEN=y
CONFIG_NEWLIB_LIBC=y
CONFIG_NEWLIB_LIBC_FLOAT_PRINTF=y
CONFIG_LOG_MODE_IMMEDIATE=y

CONFIG_GPIO=y

# GNSS sample
# Enable to use nRF Cloud A-GNSS
CONFIG_GNSS_SAMPLE_ASSISTANCE_NRF_CLOUD=n
# CONFIG_GNSS_SAMPLE_ASSISTANCE_SUPL=y
# CONFIG_GNSS_SAMPLE_SUPL_HOSTNAME="supl.google.com"

# LTE Link Control
CONFIG_LTE_LINK_CONTROL=y
# Request eDRX from the network
CONFIG_LTE_EDRX_REQ=y
# PSM requested periodic TAU 8 hours
CONFIG_LTE_PSM_REQ_RPTAU="00101000"
# PSM requested active time 6 seconds
CONFIG_LTE_PSM_REQ_RAT="00000011"

# AT Host library - Used to send AT commands directy from an UART terminal and to allow
#		    integration with nRF Connect for Desktop LTE Link monitor application.
CONFIG_AT_HOST_LIBRARY=y

# Networking
CONFIG_NETWORKING=y
CONFIG_NET_SOCKETS_OFFLOAD=y
CONFIG_NET_SOCKETS=y
CONFIG_POSIX_API=y
# Disable native network stack to save some memory
CONFIG_NET_NATIVE=n

# Memory and stack configuration
CONFIG_HEAP_MEM_POOL_SIZE=2048
CONFIG_MAIN_STACK_SIZE=4096
CONFIG_SYSTEM_WORKQUEUE_STACK_SIZE=1536

# Newlibc
CONFIG_NEWLIB_LIBC=y
CONFIG_NEWLIB_LIBC_FLOAT_PRINTF=y

# Log
CONFIG_LOG=y
CONFIG_LOG_DEFAULT_LEVEL=3

# Network
CONFIG_NETWORKING=y
CONFIG_NET_NATIVE=n
CONFIG_NET_SOCKETS=y
CONFIG_NET_SOCKETS_OFFLOAD=y
CONFIG_NET_UDP=y
CONFIG_DNS_RESOLVER=y
CONFIG_NET_SOCKETS_POSIX_NAMES=y

# LTE link control
CONFIG_LTE_LINK_CONTROL=y
CONFIG_LTE_NETWORK_MODE_LTE_M_GPS=y

# Modem library
CONFIG_NRF_MODEM_LIB=y

# Date Time library
CONFIG_DATE_TIME=y

# RTC
CONFIG_RTC=y
CONFIG_COUNTER=y
# CONFIG_PCF85063A=y

# I2C
CONFIG_I2C=y

# Accelerometer (LIS2DH)
CONFIG_SENSOR=y
CONFIG_LIS2DH=y
CONFIG_LIS2DH_ACCEL_RANGE_8G=y
CONFIG_LIS2DH_ODR_2=y

# General
CONFIG_FPU=y
CONFIG_NRF_MODEM_LIB=y
CONFIG_STDOUT_CONSOLE=y
CONFIG_UART_INTERRUPT_DRIVEN=y
CONFIG_PICOLIBC_IO_FLOAT=y
CONFIG_LOG=y
CONFIG_LOG_MODE_IMMEDIATE=y

# GNSS sample
# Enable to use nRF Cloud A-GNSS
CONFIG_GNSS_SAMPLE_ASSISTANCE_NRF_CLOUD=n

# LTE Link Control
CONFIG_LTE_LINK_CONTROL=y
# Request eDRX from the network
CONFIG_LTE_EDRX_REQ=y
# PSM requested periodic TAU 8 hours
CONFIG_LTE_PSM_REQ_RPTAU="00101000"
# PSM requested active time 6 seconds
CONFIG_LTE_PSM_REQ_RAT="00000011"

# AT Host library - Used to send AT commands directy from an UART terminal and to allow
#		    integration with nRF Connect for Desktop LTE Link monitor application.
CONFIG_AT_HOST_LIBRARY=y
CONFIG_MODEM=y
CONFIG_MODEM_CONTEXT=y

# Networking
CONFIG_NETWORKING=y
CONFIG_NET_SOCKETS_OFFLOAD=y
CONFIG_NET_SOCKETS=y
CONFIG_POSIX_API=y
# Disable native network stack to save some memory
CONFIG_NET_NATIVE=n

# Memory and stack configuration
CONFIG_HEAP_MEM_POOL_SIZE=2048
CONFIG_MAIN_STACK_SIZE=4096
CONFIG_SYSTEM_WORKQUEUE_STACK_SIZE=1536

# MCUBoot
CONFIG_BOOTLOADER_MCUBOOT=y
```

## src/gps_helper.c
```c
#include "gps_helper.h"
#include <modem/nrf_modem_lib.h>
#include <nrf_modem_at.h>
#include <zephyr/logging/log.h>

LOG_MODULE_REGISTER(gps_helper, CONFIG_LOG_DEFAULT_LEVEL);

bool gps_init(void)
{
    int err = nrf_modem_lib_init();
    if (err) {
        LOG_ERR("Modem library initialization failed: %d", err);
        return false;
    }

    // Configure modem for GNSS operation (LTE-M + GNSS mode)
    err = nrf_modem_at_printf("AT%%XSYSTEMMODE=1,0,1,0");
    if (err) {
        LOG_ERR("Failed to set system mode: %d", err);
        return false;
    }

    // Enable GNSS functionality
    err = nrf_modem_at_printf("AT+CFUN=31");
    if (err) {
        LOG_ERR("Failed to enable GNSS mode: %d", err);
        return false;
    }

    LOG_INF("GPS initialized successfully");
    return true;
}

bool gps_fetch_data(struct gps_data *data)
{
    char response[256];
    
    int err = nrf_modem_at_cmd(response, sizeof(response), "AT+CGPSINFO");
    if (err) {
        LOG_ERR("GPS data fetch failed: %d", err);
        data->valid_fix = false;
        return false;
    }

    // Check if fix is available
    if (strstr(response, "+CGPSINFO: ,,,,,,,") != NULL) {
        LOG_INF("No valid GPS fix yet.");
        data->valid_fix = false;
        return false;
    }

    // Parse NMEA response here to extract latitude, longitude, altitude...
    // For simplicity, let's assume parsing is done correctly:
    
    // Example parsed values (replace with actual parsing logic):
    data->latitude = 42.3601;
    data->longitude = -71.0589;
    data->altitude = 10.5;
    
    data->valid_fix = true;

    LOG_INF("GPS fix acquired.");
    
    return true;
}
```

## src/gps_helper.h
```c
#ifndef GPS_HELPER_H
#define GPS_HELPER_H

#include <stdbool.h>

struct gps_data {
    double latitude;
    double longitude;
    double altitude;
    bool valid_fix;
};

bool gps_init(void);
bool gps_fetch_data(struct gps_data *data);

#endif // GPS_HELPER_H
```

## src/rtc.c
```c
#include "rtc.h"
#include <zephyr/device.h>
#include <zephyr/drivers/rtc.h>
#include <zephyr/logging/log.h>
#include <stdio.h>

LOG_MODULE_REGISTER(rtc_module, CONFIG_LOG_DEFAULT_LEVEL);

static const struct device *rtc_dev;
static char datetime_str[32];

bool init_rtc(void)
{
    // Get RTC device
    rtc_dev = DEVICE_DT_GET(DT_ALIAS(rtc));
    if (!device_is_ready(rtc_dev)) {
        LOG_ERR("RTC device not ready");
        return false;
    }

    LOG_INF("RTC device initialized");
    return true;
}

int set_rtc_time(int year, int month, int day, int hour, int minute, int second)
{
    struct rtc_time time = {
        .tm_year = year - 1900,  // Years since 1900
        .tm_mon = month - 1,     // Months since January [0-11]
        .tm_mday = day,          // Day of the month [1-31]
        .tm_hour = hour,         // Hours since midnight [0-23]
        .tm_min = minute,        // Minutes after the hour [0-59]
        .tm_sec = second,        // Seconds after the minute [0-59]
        .tm_wday = -1,           // Let the RTC calculate the weekday
        .tm_yday = -1,           // Let the RTC calculate the yearday
        .tm_isdst = -1,          // Let the RTC determine DST
        .tm_nsec = 0             // Nanoseconds
    };

    int ret = rtc_set_time(rtc_dev, &time);
    if (ret) {
        LOG_ERR("Failed to set RTC time: %d", ret);
        return ret;
    }

    LOG_INF("RTC time set to %04d-%02d-%02d %02d:%02d:%02d",
            year, month, day, hour, minute, second);
    return 0;
}

void get_datetime(struct datetime *dt)
{
    struct rtc_time time;
    int ret = rtc_get_time(rtc_dev, &time);
    
    if (ret) {
        LOG_WRN("Failed to get RTC time: %d", ret);
        // Provide default values if RTC read fails
        dt->year = 2025;
        dt->month = 3;
        dt->day = 19;
        dt->hour = 20;
        dt->minute = 25;
        dt->second = 0;
        return;
    }
    
    // Convert from RTC time format to our datetime structure
    dt->year = time.tm_year + 1900;  // Convert back to calendar year
    dt->month = time.tm_mon + 1;     // Convert back to calendar month [1-12]
    dt->day = time.tm_mday;
    dt->hour = time.tm_hour;
    dt->minute = time.tm_min;
    dt->second = time.tm_sec;
}

char *get_datetime_str(void)
{
    struct datetime dt;
    get_datetime(&dt);
    
    snprintf(datetime_str, sizeof(datetime_str), 
             "%04d-%02d-%02d %02d:%02d:%02d",
             dt.year, dt.month, dt.day, dt.hour, dt.minute, dt.second);
    
    return datetime_str;
}
```

## src/rtc.h
```c
#ifndef _RTC_H_
#define _RTC_H_

#include <zephyr/kernel.h>
#include <stdbool.h>

struct datetime {
    int year;
    int month;
    int day;
    int hour;
    int minute;
    int second;
};

bool init_rtc(void);
int set_rtc_time(int year, int month, int day, int hour, int minute, int second);
void get_datetime(struct datetime *dt);
char *get_datetime_str(void);

#endif // _RTC_H_
```

## src/startup.c
```c
#include <zephyr/kernel.h>
#include <zephyr/drivers/gpio.h>
#include <zephyr/logging/log.h>
LOG_MODULE_REGISTER(startup);

#include <modem/nrf_modem_lib.h>
#include <nrf_modem_at.h>

/* Initialization of AUX pin */
#if defined(CONFIG_BOARD_NRF9160DK_NRF9160)
#define AUXANTCFG_ENABLE "AT%XANTCFG=1"

NRF_MODEM_LIB_ON_INIT(aux_init_hook, on_modem_lib_init, NULL);

static void on_modem_lib_init(int ret, void *ctx)
{
    ARG_UNUSED(ctx);

    if (ret != 0)
    {
        return;
    }

    printk("*** Setting configuration: %s ***\n", AUXANTCFG_ENABLE);
    int err = nrf_modem_at_printf("%s", AUXANTCFG_ENABLE);
    if (err)
    {
        LOG_ERR("Failed to set configuration (err: %d)", err);
    }
}
#endif
```
